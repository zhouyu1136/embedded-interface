/*********************************************************************************************
* 文件：main.c
* 作者：Lixm 2017.10.17
* 说明：风扇实验 例程  
*       通过按键控制风扇开关，并将风扇的状态打印在PC上
* 修改：2017.11.08 chennian 将led、key文件替换为通用版驱动文件
*       2018.01.02 zhoucj   修改为串口一
* 注释： 
*********************************************************************************************/

/*********************************************************************************************
* 头文件
*********************************************************************************************/
#include <ioCC2530.h>
#include "clock.h"
#include "delay.h"
#include "fan.h"
#include "uart1.h"
#include "key.h"
#include "stdio.h"
#include "string.h"


  unsigned char fan_flag = 0;                                  //风扇状态标志位
/*********************************************************************************************
* 名称：main()
* 功能：逻辑代码
* 参数：无
* 返回：无
* 修改：
* 注释：
*********************************************************************************************/
void main(void)
{
 // unsigned char fan_flag = 0;                                  //风扇状态标志位
  xtal_init();                                                  //系统时钟初始化 
  fan_init();                                                   //风扇初始化
  uart1_init(0x00,0x00);                                        //串口初始化
  time1_init();
  key_init();                                                   //按键初始化
  while(1)
  {
    if(K4 == DOWN)                                              //按键按下
    {
      delay_ms(10);                                             //按键防抖
      if(K4 == DOWN)                                            //按键按下
      {
        while(K4 == DOWN);                                      //松手检测
       
          fan_flag = 1;                                         //风扇状态标志位置1
          uart1_send_string("FAN ON,and Timer1 Start!\r\n");    //串口打印提示信息
          FAN = FAN_ON;                                        //开启风扇
        
       
      }
    }
 
  }
}
int counter= 0;
#pragma vector = T1_VECTOR
__interrupt void T1_ISR(void){

  if((FAN==FAN_ON)){
     EA=0;                                                         //关总中断
    counter++;                                                    //统计进入中断的次数
    if(counter>500)                                               //初始化中定义10ms进一次中断，经过500次中断，10ms × 500 = 5S
    {
        counter=0;                                                  //统计的次数复位
        fan_flag = 0;                                         //风扇状态标志位清零
        uart1_send_string("FAN OFF!\r\n");                    //串口打印提示信息
        FAN = FAN_OFF;                                            
    }
    T1IF=0;                                                       //中断标志位清零
    EA=1;         
}
}
